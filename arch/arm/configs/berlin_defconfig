## arch/arm/configs/berlin_defconfig
```kconfig
CONFIG_BUILTIN_DTB=y
CONFIG_ARCH_BERLIN=y
CONFIG_AEABI=y
CONFIG_CMD_ARM_MMUINFO=y
CONFIG_STACK_SIZE=0x10000
CONFIG_MALLOC_SIZE=0x800000
CONFIG_LONGHELP=y
CONFIG_CMDLINE_EDITING=y
CONFIG_AUTO_COMPLETE=y
CONFIG_DEBUG_LL=y
CONFIG_CMD_EDIT=y
CONFIG_CMD_SLEEP=y
CONFIG_CMD_MSLEEP=y
CONFIG_CMD_SAVEENV=y
CONFIG_CMD_PRINTENV=y
CONFIG_CMD_TIME=y
CONFIG_CMD_MEMINFO=y
CONFIG_CMD_MM=y
CONFIG_CMD_BOOTZ=y
CONFIG_CMD_BOOT=y
CONFIG_CMD_RESET=y
CONFIG_CMD_GO=y
CONFIG_CMD_GPIO=y
CONFIG_CMD_SPI=y
CONFIG_CMD_DETECT=y
CONFIG_OFDEVICE=y
CONFIG_DRIVER_SERIAL_NS16550=y
CONFIG_I2C=y
CONFIG_MTD=y
CONFIG_MTD_M25P80=y
CONFIG_NAND=y
CONFIG_DISK_AHCI=y
CONFIG_USB=y
CONFIG_USB_EHCI=y
CONFIG_USB_STORAGE=y
CONFIG_MCI=y
CONFIG_LED=y
CONFIG_LED_GPIO=y
CONFIG_LED_GPIO_OF=y
CONFIG_LED_TRIGGERS=y
CONFIG_KEYBOARD_GPIO=y
CONFIG_GPIO_DESIGNWARE=y
CONFIG_FS_EXT4=y
CONFIG_FS_FAT=y
CONFIG_FS_FAT_LFN=y
```

## arch/arm/mach-berlin/Kconfig
```kconfig
if ARCH_BERLIN

config ARCH_TEXT_BASE
	hex
	default 0x01000000

config BUILTIN_DTB_NAME
	string
	default "berlin2-sony-nsz-gs7" if MACH_SONY_NSZ_GS7
	default "berlin2cd-google-chromecast" if MACH_GOOGLE_CHROMECAST

choice
	prompt "Marvell Berlin SoCs"

config ARCH_BERLIN_BG2
	bool "Armada 1500 (BG2)"
	select ARM_SMP_TWD
	select CPU_V7

config ARCH_BERLIN_BG2CD
	bool "Armada 1500-mini (BG2CD)"
	select ARM_SMP_TWD
	select CPU_V7

endchoice

choice
	prompt "Marvell Berlin SoC board"

#
# Armada 1500 (BG2) SoC boards
#

config MACH_SONY_NSZ_GS7
	bool "Sony NSZ-GS7"
	depends on ARCH_BERLIN_BG2

#
# Armada 1500-mini (BG2CD) SoC boards
#

config MACH_GOOGLE_CHROMECAST
	bool "Google Chromecast"
	depends on ARCH_BERLIN_BG2CD

endchoice

endif # ARCH_BERLIN
```
